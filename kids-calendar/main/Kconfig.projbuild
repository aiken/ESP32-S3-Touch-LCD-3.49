## kids-calendar/main/Kconfig.projbuild
```kconfig
menu "Calendar App Configuration"

config WIFI_SSID
    string "Wi-Fi SSID"
    default "YOUR_WIFI_SSID"
    help
        Your Wi-Fi network name

config WIFI_PASSWORD
    string "Wi-Fi Password"
    default "YOUR_WIFI_PASSWORD"
    help
        Your Wi-Fi password

config API_USE_HTTPS
    bool "Use HTTPS (Cloudflare Tunnel)"
    default y
    help
        Use HTTPS for external access, HTTP for local network

config API_HOST
    string "API Host"
    default "calendar.yourdomain.com"
    help
        API server hostname (HTTPS) or IP (HTTP)

config API_PORT
    int "API Port"
    default 443
    help
        API server port (443 for HTTPS, 3000 for HTTP)

config API_PATH
    string "API Base Path"
    default "/api"
    help
        API base path

config KID_PROFILE
    string "Kid profile (meixi / zhuangzhuang)"
    default "meixi"
    help
        Which kid's courses this device shows

config API_LAN_URL
    string "API LAN URL (preferred)"
    default "http://192.168.1.100:3001"
    help
        LAN base URL of the calendar server, tried FIRST.
        Example: http://192.168.1.100:3001

config API_CLOUD_URL
    string "API Cloud URL (fallback, Cloudflare Tunnel)"
    default ""
    help
        HTTPS base URL via Cloudflare Tunnel, used when LAN fails.
        Leave empty to disable the fallback.
        Example: https://calendar.example.com

config DEVICE_KEY
    string "Device API Key"
    default "devkey-change-me"
    help
        Sent as X-Device-Key header to the calendar server

config TIMEZONE_OFFSET
    int "Timezone Offset (hours)"
    default 8
    help
        Timezone offset from UTC (Beijing = 8)

config NTP_SERVER
    string "NTP Server"
    default "pool.ntp.org"
    help
        NTP server for time synchronization

endmenu
```
